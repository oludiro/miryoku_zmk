// Copyright 2021 Manna Harbour
// https://github.com/manna-harbour/miryoku

#include "../miryoku/custom_config.h"
#include "../miryoku/mapping/36/minidox.h"

#define ZMK_POINTING_DEFAULT_MOVE_VAL 2000
#define U_MOUSE_MOVE_TIME 750

// Swap the Miryoku modifier positions for Ahokore only.
#include <dt-bindings/zmk/keys.h>
#undef LGUI
#undef LCTRL
#define LGUI LEFT_CONTROL
#define LCTRL LEFT_GUI

#include "../miryoku/miryoku.dtsi"

// The out-of-tree board supplies these pinctrl states but omits their names.
&uart0 {
  pinctrl-names = "default", "sleep";
};

&i2c0 {
  pinctrl-names = "default", "sleep";
};
